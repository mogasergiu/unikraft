#include <uk/plat/common/common.lds.h>

PHDRS
{
	tls PT_TLS;
	tls_load PT_LOAD;
}

SECTIONS
{
	EXCEPTION_SECTIONS

	CTORTAB_SECTION

	INITTAB_SECTION

	EVENTTAB_SECTION
}
INSERT BEFORE .rodata

SECTIONS
{
	TLS_SECTIONS
}
INSERT BEFORE .data
